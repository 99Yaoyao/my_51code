#include <REGX52.H>
#include "Delay.h"
#include "LEDMatrix.h"
#include "Timer.h"

u8 code  ch[] = {
    0x30,0x40,0x7F,0x88,0x7F,0x40,0x34,0x00,
    0x00,0x00,0x7F,0xA8,0x7F,0x50,0x34,0x00,
    0x30,0x40,0x7F,0xA8,0x7F,0x60,0x00,0x00,
    0x10,0x20,0x5E,0x8A,0x7F,0x20,0x10,0x00,
    0x10,0x29,0x7E,0x88,0x7E,0x21,0x30,0x00,
    0x10,0x29,0x7F,0xC8,0x1E,0x69,0x39,0x00,
};

u8 offset = 0;
int main(void)//显示动画
{
    u8 i = 0;
    LEDMatrix_Init();
    Timer0_Init();
	for(;;)
	{
        for(i = 0;i<8;i++)
        {
            LEDjuzhen_ShowGraph(i,ch[i+offset]);
        }
	}
	return 0;
}

void Timer0_Routine() interrupt 1
{
    static unsigned int T0Count;
	TL0 = 0x66;				
	TH0 = 0xFC;
    T0Count++;
    if(T0Count==500)
    {
        offset+=8;
        if(offset == 40)
            offset = 0;
        T0Count = 0;
    }
}




